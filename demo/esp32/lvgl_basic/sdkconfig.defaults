## demo/esp32/lvgl_basic/sdkconfig.defaults
```kconfig
#
# Serial flasher config
#
CONFIG_ESPTOOLPY_FLASHSIZE_4MB=y
# end of Serial flasher config

#
# LVGL configuration
#
CONFIG_LV_CONF_SKIP=y
CONFIG_LV_HOR_RES_MAX=240
CONFIG_LV_VER_RES_MAX=320
CONFIG_LV_COLOR_16_SWAP=y
# end of LVGL configuration

#
# LVGL TFT Display controller
#
CONFIG_LV_PREDEFINED_DISPLAY_WROVER4=y
CONFIG_DISPLAY_ORIENTATION_LANDSCAPE_INVERTED=y
# end of LVGL TFT Display controller
```

## demo/sound_spectrum/sdkconfig.defaults
```kconfig
CONFIG_APP_PROJECT_VER_FROM_CONFIG=y
CONFIG_APP_PROJECT_VER="1.1.2"

CONFIG_ESPTOOLPY_FLASHSIZE_4MB=y

CONFIG_BT_ENABLED=y
CONFIG_BT_NIMBLE_ENABLED=y

CONFIG_ESP_SYSTEM_SINGLE_CORE_MODE=y
CONFIG_FREERTOS_UNICORE=y
```
